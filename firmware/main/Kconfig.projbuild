## firmware/main/Kconfig.projbuild
```kconfig
menu "Firmware Configuration"

config WIFI_SSID
    string "WiFi SSID"
	default "myssid"
	help
		SSID (network name) for the example to connect to.

config WIFI_PASSWORD
    string "WiFi Password"
	default "myssid"
	help
		WiFi password (WPA or WPA2) for the example to use.

		Can be left blank if the network has no security set.

config SERVER_IP
    string "HTTP Server IP"
	default "192.168.178.100"
	help
		HTTP Server IP to download the image file from.

		See example README.md for details.

config SERVER_UDP_PORT
	string "UDP Server Port"
	default "16983"
	help
		UDP port on server to receive maintenance messages
		Should be chosen not to conflict with any other port used
		on the system.

endmenu
```
